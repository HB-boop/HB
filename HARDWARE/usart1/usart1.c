#include "usart1.h"
#include "includes.h"

u8 rx1_num=0,tx1_num=0,tx1_nums=0,usart1_flag=0;
u8 rx1_dat[50],tx1_dat[50]="HB  ";

extern OS_SEM	usart1_sem;

/* CRC  High */
const unsigned char   auchCRCHi[] = {
	0x00, 0xC1, 0x81, 0x40, 0x01, 0xC0, 0x80, 0x41, 0x01, 0xC0,
	0x80, 0x41, 0x00, 0xC1, 0x81, 0x40, 0x01, 0xC0, 0x80, 0x41,
	0x00, 0xC1, 0x81, 0x40, 0x00, 0xC1, 0x81, 0x40, 0x01, 0xC0,
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	0x80, 0x41, 0x00, 0xC1, 0x81, 0x40
} ;
/* CRC Low*/
const unsigned char  auchCRCLo[] = {
	0x00, 0xC0, 0xC1, 0x01, 0xC3, 0x03, 0x02, 0xC2, 0xC6, 0x06,
	0x07, 0xC7, 0x05, 0xC5, 0xC4, 0x04, 0xCC, 0x0C, 0x0D, 0xCD,
	0x0F, 0xCF, 0xCE, 0x0E, 0x0A, 0xCA, 0xCB, 0x0B, 0xC9, 0x09,
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	0x43, 0x83, 0x41, 0x81, 0x80, 0x40
} ;

/********************************************************
@函数名		：	GetCheckCode
@时间			：	2016-03-15
@功能			：	获得16位CRC
@输入参数	：	puchMsg:数组指针	usDataLen：数据长度
@返回值		：	CRC值
@备注			：	
********************************************************/
u16 GetCheckCode(u8 *puchMsg,u8 usDataLen)
{
	u8 uchCRCHi=0xFF;
	u8 uchCRCLo=0xFF;
	unsigned long uIndex;
	while(usDataLen--)
	{
		uIndex=uchCRCHi^*puchMsg++;
		uchCRCHi=uchCRCLo^auchCRCHi[uIndex];
		uchCRCLo=auchCRCLo[uIndex];
	}
	return (uchCRCHi<<8|uchCRCLo);
}

/********************************************************
@函数名		：	usart1_Init
@时间			：	2016-03-15
@功能			：	初始化串口1
@输入参数	：	无
@返回值		：	无
@备注			：	占用引脚：PA9  PA10
********************************************************/
void usart1_Init(void)
{
	GPIO_InitTypeDef	GPIO_InitStructure;
	USART_InitTypeDef	USART_InitStructure;
	NVIC_InitTypeDef	NVIC_InitStructure;

	RCC_APB2PeriphClockCmd(RCC_APB2Periph_GPIOA,ENABLE);
	RCC_APB2PeriphClockCmd(RCC_APB2Periph_USART1,ENABLE);
	
	NVIC_InitStructure.NVIC_IRQChannel=USART1_IRQn;								//中断初始化
	NVIC_InitStructure.NVIC_IRQChannelPreemptionPriority=1;
	NVIC_InitStructure.NVIC_IRQChannelSubPriority=0;
	NVIC_InitStructure.NVIC_IRQChannelCmd=ENABLE;
	NVIC_Init(&NVIC_InitStructure);
	
	GPIO_InitStructure.GPIO_Pin=GPIO_Pin_9;						//引脚初始化
	GPIO_InitStructure.GPIO_Mode=GPIO_Mode_AF_PP;//	TX  复用推挽输出
	GPIO_InitStructure.GPIO_Speed=GPIO_Speed_50MHz;
	GPIO_Init(GPIOA,&GPIO_InitStructure);
	GPIO_InitStructure.GPIO_Pin=GPIO_Pin_10;
	GPIO_InitStructure.GPIO_Mode=GPIO_Mode_IN_FLOATING;//	RX  浮空输入
	GPIO_Init(GPIOA,&GPIO_InitStructure);
	
	USART_DeInit(USART1);													//复位串口1

	USART_InitStructure.USART_BaudRate=115200;  								//串口初始化
	USART_InitStructure.USART_WordLength=USART_WordLength_8b;
	USART_InitStructure.USART_StopBits=USART_StopBits_1;
	USART_InitStructure.USART_Parity=USART_Parity_No;
	USART_InitStructure.USART_Mode=USART_Mode_Tx|USART_Mode_Rx;
	USART_InitStructure.USART_HardwareFlowControl=USART_HardwareFlowControl_None;
	USART_Init(USART1,&USART_InitStructure);

	USART_ITConfig(USART1,USART_IT_RXNE,ENABLE);
	USART_Cmd(USART1,ENABLE);
}

/********************************************************
@函数名		：	usart1_send
@时间			：	2016-03-15
@功能			：	通过串口1发送数据
@输入参数	：	len：发送数据长度
@返回值		：	无
@备注			：	当发送1个字节的时候不能开中断，不知道为什么
********************************************************/
void usart1_Send(u8 len)
{
	tx1_num=0;
	if(len>1)
	{
		tx1_nums=len;
		USART_SendData(USART1,tx1_dat[0]);
		USART_ITConfig(USART1,USART_IT_TXE,ENABLE);
	}
	else
	{
		tx1_nums=1;
		USART_SendData(USART1,tx1_dat[0]); 		
	}
}

/********************************************************
@函数名		：	USART1_IRQHandler
@时间			：	2016-03-15
@功能			：	串口1中断函数
@输入参数	：	无
@返回值		：	无
@备注			：	接收到4个字节即认为接收完毕
********************************************************/
void USART1_IRQHandler(void)
{
	OS_ERR	err;
	
	OSIntEnter();
	  
	if(USART_GetITStatus(USART1,USART_IT_RXNE)!=RESET)	 //接收中断
	{
		USART_ClearITPendingBit(USART1,USART_IT_RXNE);
		rx1_dat[rx1_num]=USART_ReceiveData(USART1);
		rx1_num++;
		if(rx1_num>=4)
		{
			rx1_num=0;
			OSSemPost(&usart1_sem,OS_OPT_POST_ALL,&err);
		}
	}
	if(USART_GetITStatus(USART1,USART_IT_TXE)!=RESET)	 //发送数据寄存器空中断
	{ 		
		tx1_num++;
		if(tx1_num<tx1_nums)
		{
			USART_SendData(USART1,tx1_dat[tx1_num]);
		}
		else
		{
			tx1_num=0; 
			
			USART_ITConfig(USART1,USART_IT_TXE,DISABLE);
			USART_ITConfig(USART1,USART_IT_TC,ENABLE);
		}
	}
	if(USART_GetITStatus(USART1,USART_IT_TC)!=RESET)
	{
		USART_ClearITPendingBit(USART1,USART_IT_TC);
		USART_ITConfig(USART1,USART_IT_TC,DISABLE);
	}
	
	OSIntExit();                                            /* Tell uC/OS-III that we are leaving the ISR             */
}



